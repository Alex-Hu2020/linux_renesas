## drivers/staging/rtl88x2cs/Kconfig
```kconfig
config RTL8822BS
	tristate "Realtek 8822C SDIO WiFi"
	help
	  Help message of RTL8822CS

config RTL8822CS
        tristate "Realtek 8822C SDIO WiFi"
        help
          Help message of RTL8822CS
```
